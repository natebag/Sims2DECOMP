/* Auto-generated symbol definitions for the linker */
/* Bridges the naming gap between GCC Itanium mangling and SN Systems mangling */
/* Generated by tools/gen_linker_stubs.py - DO NOT EDIT */

/* ========== ALIASES: GCC mangled -> SN Systems skeleton ========== */

/* ActionQueue::Insert(Interaction&, unsigned int) */
PROVIDE(_ZN11ActionQueue6InsertER11Interactionj = ActionQueue__Insert_Interaction_ref__unsigned_int);
/* ActionQueue::SetActionText(BString2&, unsigned int) */
PROVIDE(_ZN11ActionQueue13SetActionTextER8BString2j = ActionQueue__SetActionText_BString2_ref__unsigned_int);
/* AltToIso(float&) */
PROVIDE(_Z8AltToIsoRf = AltToIso_float_ref);
/* AptDisplayList::removeObject(AptCIH*) */
PROVIDE(_ZN14AptDisplayList12removeObjectEP6AptCIH = AptDisplayList__removeObject_AptCIH_ptr);
/* AptDisplayList::removeObject(int) */
PROVIDE(_ZN14AptDisplayList12removeObjectEi = AptDisplayList__removeObject_int);
/* AptNonGCAllocSaveSize */
PROVIDE(AptNonGCAllocSaveSize = AptNonGCAllocSaveSize_unsigned_int);
/* AptNonGCAllocSaveSize(unsigned int) */
PROVIDE(_Z21AptNonGCAllocSaveSizej = AptNonGCAllocSaveSize_unsigned_int);
/* AptNonGCFreeSavedSize */
PROVIDE(AptNonGCFreeSavedSize = AptNonGCFreeSavedSize_void_ptr);
/* AptNonGCFreeSavedSize(void*) */
PROVIDE(_Z21AptNonGCFreeSavedSizePv = AptNonGCFreeSavedSize_void_ptr);
/* AptPseudoDisplayList::Remove(AptPseudoCIH_t*) */
PROVIDE(_ZN20AptPseudoDisplayList6RemoveEP14AptPseudoCIH_t = AptPseudoDisplayList__Remove_AptPseudoCIH_t_ptr);
/* Behavior::Init(Language*, ObjSelector*) */
PROVIDE(_ZN8Behavior4InitEP8LanguageP11ObjSelector = Behavior__Init_Language_ptr__ObjSelector_ptr);
/* Behavior::~Behavior() */
PROVIDE(_ZN8BehaviorD2Ev = Behavior__dtor_Behavior_void);
/* CasEventDummyPrintf */
PROVIDE(CasEventDummyPrintf = CasEventDummyPrintf_char_ptr_varargs);
/* CasSimRenderer::Draw(ERC*) */
PROVIDE(_ZN14CasSimRenderer4DrawEP3ERC = CasSimRenderer__Draw_ERC_ptr);
/* CasSimRendererDynamic::GetIndexes(eTattooTextureTypeS2C, unsigned char*, unsigned char*) */
PROVIDE(_ZN21CasSimRendererDynamic10GetIndexesE21eTattooTextureTypeS2CPhS1_ = CasSimRendererDynamic__GetIndexes_eTattooTextureTypeS2C__unsigned_char_ptr__unsigned_char_ptr);
/* Commander::sId */
PROVIDE(_ZN9Commander3sIdE = Commander__sId);
/* Commander::sList */
PROVIDE(_ZN9Commander5sListE = Commander__sList);
/* CreateTheWorld */
PROVIDE(CreateTheWorld = CreateTheWorld_void);
/* EA::Allocator::GeneralAllocator::MallocAligned(unsigned int, unsigned int, unsigned int, int) */
PROVIDE(_ZN2EA9Allocator16GeneralAllocator13MallocAlignedEjjji = EA__Allocator__GeneralAllocator__MallocAligned_unsigned_int__unsigned_int__unsigned_int__int);
/* EA::Allocator::GeneralAllocator::Realloc(void*, unsigned int, int) */
PROVIDE(_ZN2EA9Allocator16GeneralAllocator7ReallocEPvji = EA__Allocator__GeneralAllocator__Realloc_void_ptr__unsigned_int__int);
/* EA::Allocator::GeneralAllocator::~GeneralAllocator() */
PROVIDE(_ZN2EA9Allocator16GeneralAllocatorD2Ev = EA__Allocator__GeneralAllocator__dtor_GeneralAllocator_void);
/* EAHeap::EAHeap(char*, void*, unsigned int, EAHeap*, EAHeap*) */
PROVIDE(_ZN6EAHeapC2EPcPvjPS_S2_ = EAHeap__EAHeap_char_ptr__void_ptr__unsigned_int__EAHeap_ptr__EAHeap_ptr);
/* EAHeap::Free(void*) */
PROVIDE(_ZN6EAHeap4FreeEPv = EAHeap__Free_void_ptr);
/* EAHeap::Malloc(unsigned int, int) */
PROVIDE(_ZN6EAHeap6MallocEji = EAHeap__Malloc_unsigned_int__int);
/* EAHeap::s_poolBlocks */
PROVIDE(_ZN6EAHeap12s_poolBlocksE = EAHeap__s_poolBlocks);
/* EBitArray::Add(unsigned int, int) */
PROVIDE(_ZN9EBitArray3AddEji = EBitArray__Add_unsigned_int__int);
/* EBitArray::Get(int, int) const */
PROVIDE(_ZNK9EBitArray3GetEii = EBitArray__Get_int__int__const);
/* EBitArray::Insert(EBitArray&, int, int, int) */
PROVIDE(_ZN9EBitArray6InsertERS_iii = EBitArray__Insert_EBitArray_ref__int__int__int);
/* EBitArray::Insert(bool, int) */
PROVIDE(_ZN9EBitArray6InsertEbi = EBitArray__Insert_bool__int);
/* EBound3::CalcBoundSphere(EBoundSphere&) */
PROVIDE(_ZN7EBound315CalcBoundSphereER12EBoundSphere = EBound3__CalcBoundSphere_EBoundSphere_ref);
/* EFileSystem::EFileSystem() */
PROVIDE(_ZN11EFileSystemC2Ev = EFileSystem__EFileSystem_void);
/* EFixedPool::Init(int, int, void*) */
PROVIDE(_ZN10EFixedPool4InitEiiPv = EFixedPool__Init_int__int__void_ptr);
/* EFixedString::Concatonate(char*, char*) */
PROVIDE(_ZN12EFixedString11ConcatonateEPcS0_ = EFixedString__Concatonate_char_ptr__char_ptr);
/* EFixedString::Convert(float) */
PROVIDE(_ZN12EFixedString7ConvertEf = EFixedString__Convert_float);
/* EFixedString::TrimLeft(char*) */
PROVIDE(_ZN12EFixedString8TrimLeftEPc = EFixedString__TrimLeft_char_ptr);
/* EFixedString::TrimRight(char*) */
PROVIDE(_ZN12EFixedString9TrimRightEPc = EFixedString__TrimRight_char_ptr);
/* EGlobalManager::m_nStartedUpClients */
PROVIDE(_ZN14EGlobalManager19m_nStartedUpClientsE = EGlobalManager__m_nStartedUpClients);
/* EGlobalManager::m_shutdownComplete */
PROVIDE(_ZN14EGlobalManager18m_shutdownCompleteE = EGlobalManager__m_shutdownComplete);
/* EGlobalManager::m_startupComplete */
PROVIDE(_ZN14EGlobalManager17m_startupCompleteE = EGlobalManager__m_startupComplete);
/* EGraphics::SetBloom() */
PROVIDE(_ZN9EGraphics8SetBloomEv = EGraphics__SetBloom_void);
/* EHashTable::Find(unsigned int, unsigned int) const */
PROVIDE(_ZNK10EHashTable4FindEjj = EHashTable__Find_unsigned_int__unsigned_int__const);
/* EHashTable::Remove(unsigned int, HTIteratorPtrType*) */
PROVIDE(_ZN10EHashTable6RemoveEjP17HTIteratorPtrType = EHashTable__Remove_unsigned_int__HTIteratorPtrType_ptr);
/* EIAmbLight::m_typeInfo */
PROVIDE(_ZN10EIAmbLight10m_typeInfoE = EIAmbLight__m_typeInfo);
/* EIDirLight::m_typeInfo */
PROVIDE(_ZN10EIDirLight10m_typeInfoE = EIDirLight__m_typeInfo);
/* EIGameInstance::m_typeInfo */
PROVIDE(_ZN14EIGameInstance10m_typeInfoE = EIGameInstance__m_typeInfo);
/* EILight::m_typeInfo */
PROVIDE(_ZN7EILight10m_typeInfoE = EILight__m_typeInfo);
/* EIPointAmbLight::m_typeInfo */
PROVIDE(_ZN15EIPointAmbLight10m_typeInfoE = EIPointAmbLight__m_typeInfo);
/* EIPointLight::m_typeInfo */
PROVIDE(_ZN12EIPointLight10m_typeInfoE = EIPointLight__m_typeInfo);
/* EISpotLight::m_typeInfo */
PROVIDE(_ZN11EISpotLight10m_typeInfoE = EISpotLight__m_typeInfo);
/* EIStaticModel::m_typeInfo */
PROVIDE(_ZN13EIStaticModel10m_typeInfoE = EIStaticModel__m_typeInfo);
/* EIStaticSubModel::m_typeInfo */
PROVIDE(_ZN16EIStaticSubModel10m_typeInfoE = EIStaticSubModel__m_typeInfo);
/* EORDbgTrace */
PROVIDE(EORDbgTrace = EORDbgTrace_char_ptr_varargs);
/* ERLevel::m_typeInfo */
PROVIDE(_ZN7ERLevel10m_typeInfoE = ERLevel__m_typeInfo);
/* ERedBlackTree::InsertAt(ERedBlackTreeNode*, unsigned int, unsigned int) */
PROVIDE(_ZN13ERedBlackTree8InsertAtEP17ERedBlackTreeNodejj = ERedBlackTree__InsertAt_ERedBlackTreeNode_ptr__unsigned_int__unsigned_int);
/* ERedBlackTree::Remove(RBIteratorPtrType*) */
PROVIDE(_ZN13ERedBlackTree6RemoveEP17RBIteratorPtrType = ERedBlackTree__Remove_RBIteratorPtrType_ptr);
/* ERedBlackTree::m_sentinel */
PROVIDE(_ZN13ERedBlackTree10m_sentinelE = ERedBlackTree__m_sentinel);
/* EString2::Convert(float) */
PROVIDE(_ZN8EString27ConvertEf = EString2__Convert_float);
/* EString2::Deallocate(unsigned short*) */
PROVIDE(_ZN8EString210DeallocateEPt = EString2__Deallocate_unsigned_wchar_t_ptr);
/* EString2::MakeCopy(unsigned short*) */
PROVIDE(_ZN8EString28MakeCopyEPt = EString2__MakeCopy_unsigned_wchar_t_ptr);
/* EString::Allocate(int) */
PROVIDE(_ZN7EString8AllocateEi = EString__Allocate_int);
/* EString::Convert(float) */
PROVIDE(_ZN7EString7ConvertEf = EString__Convert_float);
/* EString::EString(char*, char*) */
PROVIDE(_ZN7EStringC1EPcS0_ = EString__EString_char_ptr__char_ptr);
/* EString::MakeCopy(char*) */
PROVIDE(_ZN7EString8MakeCopyEPc = EString__MakeCopy_char_ptr);
/* EString::TrimLeft(char) */
PROVIDE(_ZN7EString8TrimLeftEc = EString__TrimLeft_char);
/* EString::TrimLeft(char*) */
PROVIDE(_ZN7EString8TrimLeftEPc = EString__TrimLeft_char_ptr);
/* EString::TrimRight(char) */
PROVIDE(_ZN7EString9TrimRightEc = EString__TrimRight_char);
/* EString::TrimRight(char*) */
PROVIDE(_ZN7EString9TrimRightEPc = EString__TrimRight_char_ptr);
/* EString::m_null */
PROVIDE(_ZN7EString6m_nullE = EString__m_null);
/* GetCircleCircleIX(EVec2&, float, EVec2&, EVec2&, float, EVec2&, Intersection&) */
PROVIDE(_Z17GetCircleCircleIXR5EVec2fS0_S0_fS0_R12Intersection = GetCircleCircleIX_EVec2_ref__float__EVec2_ref__EVec2_ref__float__EVec2_ref__Intersection_ref);
/* GetLocalizableCommandTable::GetLocalizableCommandTable() */
PROVIDE(_ZN26GetLocalizableCommandTableC1Ev = GetLocalizableCommandTable__GetLocalizableCommandTable_void);
/* GetLocalizableCommandTable::s_pInstance */
PROVIDE(_ZN26GetLocalizableCommandTable11s_pInstanceE = GetLocalizableCommandTable__s_pInstance);
/* GetTotalSaveGameSize */
PROVIDE(GetTotalSaveGameSize = GetTotalSaveGameSize_void);
/* GetVariableCommandTable::GetVariableCommandTable() */
PROVIDE(_ZN23GetVariableCommandTableC1Ev = GetVariableCommandTable__GetVariableCommandTable_void);
/* GetVariableCommandTable::s_pInstance */
PROVIDE(_ZN23GetVariableCommandTable11s_pInstanceE = GetVariableCommandTable__s_pInstance);
/* GoalUnlock::DoStream(ReconBuffer*, int) */
PROVIDE(_ZN10GoalUnlock8DoStreamEP11ReconBufferi = GoalUnlock__DoStream_ReconBuffer_ptr__int);
/* GoalUnlock::GetObjectIndexFromGuid(int) */
PROVIDE(_ZN10GoalUnlock22GetObjectIndexFromGuidEi = GoalUnlock__GetObjectIndexFromGuid_int);
/* GoalUnlock::GetUnlockCount(IGoalUnlock::UnlockType) */
PROVIDE(_ZN10GoalUnlock14GetUnlockCountEN11IGoalUnlock10UnlockTypeE = GoalUnlock__GetUnlockCount_IGoalUnlock__UnlockType);
/* GoalUnlock::GetUnlockTotal(IGoalUnlock::UnlockType) */
PROVIDE(_ZN10GoalUnlock14GetUnlockTotalEN11IGoalUnlock10UnlockTypeE = GoalUnlock__GetUnlockTotal_IGoalUnlock__UnlockType);
/* GoalUnlock::GrantUnlock(IGoalUnlock::UnlockType, short) */
PROVIDE(_ZN10GoalUnlock11GrantUnlockEN11IGoalUnlock10UnlockTypeEs = GoalUnlock__GrantUnlock_IGoalUnlock__UnlockType__short);
/* GoalUnlock::IsRecentlyUnlocked(IGoalUnlock::UnlockType, short) */
PROVIDE(_ZN10GoalUnlock18IsRecentlyUnlockedEN11IGoalUnlock10UnlockTypeEs = GoalUnlock__IsRecentlyUnlocked_IGoalUnlock__UnlockType__short);
/* GoalUnlock::IsUnlocked(IGoalUnlock::UnlockType, short) */
PROVIDE(_ZN10GoalUnlock10IsUnlockedEN11IGoalUnlock10UnlockTypeEs = GoalUnlock__IsUnlocked_IGoalUnlock__UnlockType__short);
/* GoalUnlock::SetRecentlyUnlocked(IGoalUnlock::UnlockType, short, bool) */
PROVIDE(_ZN10GoalUnlock19SetRecentlyUnlockedEN11IGoalUnlock10UnlockTypeEsb = GoalUnlock__SetRecentlyUnlocked_IGoalUnlock__UnlockType__short__bool);
/* IFFBehavior::CountTrees(short) */
PROVIDE(_ZN11IFFBehavior10CountTreesEs = IFFBehavior__CountTrees_short);
/* IFFBehavior::GetTreeByIndex(int, short, ObjectDataBehaviorTree**) */
PROVIDE(_ZN11IFFBehavior14GetTreeByIndexEisPP22ObjectDataBehaviorTree = IFFBehavior__GetTreeByIndex_int__short__ObjectDataBehaviorTree_ptrp);
/* IFFBehavior::GetTreeIDByName(char*) */
PROVIDE(_ZN11IFFBehavior15GetTreeIDByNameEPc = IFFBehavior__GetTreeIDByName_char_ptr);
/* IFFBehavior::QueryInterface(unsigned int, void**) */
PROVIDE(_ZN11IFFBehavior14QueryInterfaceEjPPv = IFFBehavior__QueryInterface_unsigned_int__void_ptrp);
/* IFFBehavior::Release() */
PROVIDE(_ZN11IFFBehavior7ReleaseEv = IFFBehavior__Release_void);
/* ISimsMultiTileObjectModel::ISimsMultiTileObjectModel() */
PROVIDE(_ZN25ISimsMultiTileObjectModelC1Ev = ISimsMultiTileObjectModel__ISimsMultiTileObjectModel_void);
/* ISimsObjectModel::ISimsObjectModel() */
PROVIDE(_ZN16ISimsObjectModelC1Ev = ISimsObjectModel__ISimsObjectModel_void);
/* ISimsObjectModel::SetInitalObjectState() */
PROVIDE(_ZN16ISimsObjectModel20SetInitalObjectStateEv = ISimsObjectModel__SetInitalObjectState_void);
/* ISimsObjectModel::SetSOMModel(unsigned int) */
PROVIDE(_ZN16ISimsObjectModel11SetSOMModelEj = ISimsObjectModel__SetSOMModel_unsigned_int);
/* ISimsObjectModel::UpdateAnimTrack(ObjAnimDef*, bool) */
PROVIDE(_ZN16ISimsObjectModel15UpdateAnimTrackEP10ObjAnimDefb = ISimsObjectModel__UpdateAnimTrack_ObjAnimDef_ptr__bool);
/* ISimsWallObjectModel::ISimsWallObjectModel() */
PROVIDE(_ZN20ISimsWallObjectModelC1Ev = ISimsWallObjectModel__ISimsWallObjectModel_void);
/* IsoToAlt(float&) */
PROVIDE(_Z8IsoToAltRf = IsoToAlt_float_ref);
/* MainHeap */
PROVIDE(MainHeap = MainHeap_void);
/* MainHeap() */
PROVIDE(_Z8MainHeapv = MainHeap_void);
/* PoolAlloc(void*, void*, unsigned int) */
PROVIDE(_Z9PoolAllocPvS_j = PoolAlloc);
/* PoolFree(void*, void*) */
PROVIDE(_Z8PoolFreePvS_ = PoolFree);
/* RoutingSlot::WriteSlot(SlotDescriptor*) */
PROVIDE(_ZN11RoutingSlot9WriteSlotEP14SlotDescriptor = RoutingSlot__WriteSlot_SlotDescriptor_ptr);
/* SAnimator2::m_DualArmCarryIndexArray */
PROVIDE(_ZN10SAnimator224m_DualArmCarryIndexArrayE = SAnimator2__m_DualArmCarryIndexArray);
/* SAnimator2::m_pendingCount */
PROVIDE(_ZN10SAnimator214m_pendingCountE = SAnimator2__m_pendingCount);
/* SetVariableCommandTable::SetVariableCommandTable() */
PROVIDE(_ZN23SetVariableCommandTableC1Ev = SetVariableCommandTable__SetVariableCommandTable_void);
/* SetVariableCommandTable::s_pInstance */
PROVIDE(_ZN23SetVariableCommandTable11s_pInstanceE = SetVariableCommandTable__s_pInstance);
/* Sprintf */
PROVIDE(Sprintf = Sprintf_char_ptr__char_ptr_varargs);
/* SpriteSlot::ActivateForTicks(int) */
PROVIDE(_ZN10SpriteSlot16ActivateForTicksEi = SpriteSlot__ActivateForTicks_int);
/* StringBuffer::append(StringBuffer&, int) */
PROVIDE(_ZN12StringBuffer6appendERS_i = StringBuffer__append_StringBuffer_ref__int);
/* TileWalls::Rotate(int) */
PROVIDE(_ZN9TileWalls6RotateEi = TileWalls__Rotate_int);
/* UI2D::FindEntry(char*) */
PROVIDE(_ZN4UI2D9FindEntryEPc = UI2D__FindEntry_char_ptr);
/* UI2D::UI2D() */
PROVIDE(_ZN4UI2DC1Ev = UI2D__UI2D_void);
/* UI2D::s_pInstance */
PROVIDE(_ZN4UI2D11s_pInstanceE = UI2D__s_pInstance);
/* UI3D::FindEntry(char*) */
PROVIDE(_ZN4UI3D9FindEntryEPc = UI3D__FindEntry_char_ptr);
/* UI3D::UI3D() */
PROVIDE(_ZN4UI3DC1Ev = UI3D__UI3D_void);
/* UI3D::s_pInstance */
PROVIDE(_ZN4UI3D11s_pInstanceE = UI3D__s_pInstance);
/* UIButtonImages::instance */
PROVIDE(_ZN14UIButtonImages8instanceE = UIButtonImages__instance);
/* UIDrawTable::UIDrawTable() */
PROVIDE(_ZN11UIDrawTableC1Ev = UIDrawTable__UIDrawTable_void);
/* UIDrawTable::s_pInstance */
PROVIDE(_ZN11UIDrawTable11s_pInstanceE = UIDrawTable__s_pInstance);
/* VprintfCore8 */
PROVIDE(VprintfCore8 = VprintfCore8_bool__p__char_ptr__unsigned_int__void_ptr__void_ptr__char_ptr__va_list_tag_ptr);
/* cFixedWorldImpl::cFixedWorldImpl(int, int) */
PROVIDE(_ZN15cFixedWorldImplC1Eii = cFixedWorldImpl__cFixedWorldImpl_int__int);
/* cXObjectImpl::GetPlacementSpec(PlacementSpec*) */
PROVIDE(_ZN12cXObjectImpl16GetPlacementSpecEP13PlacementSpec = cXObjectImpl__GetPlacementSpec_PlacementSpec_ptr);
/* cXObjectImpl::HierGetChild(int) */
PROVIDE(_ZN12cXObjectImpl12HierGetChildEi = cXObjectImpl__HierGetChild_int);
/* cXObjectImpl::HierGetSite(HierarchySite*) */
PROVIDE(_ZN12cXObjectImpl11HierGetSiteEP13HierarchySite = cXObjectImpl__HierGetSite_HierarchySite_ptr);
/* memset(void*, int, unsigned int) */
PROVIDE(_Z6memsetPvij = memset);
/* timeGetTime */
PROVIDE(timeGetTime = timeGetTime_void);

/* ========== STUBS: Symbols not found in skeleton ========== */
/* Placeholders at valid addresses to avoid relocation overflow. */
/* They will be replaced as more code is decompiled. */

/* AmbientScorePlayer_GetVolume(void*) */
PROVIDE(_Z28AmbientScorePlayer_GetVolumePv = 0x800034C0);
/* AmbientScorePlayer_Pause(void*, int) */
PROVIDE(_Z24AmbientScorePlayer_PausePvi = 0x800034C0);
/* AmbientScorePlayer_SetVolume(void*, int) */
PROVIDE(_Z28AmbientScorePlayer_SetVolumePvi = 0x800034C0);
/* AptNativeHash_DestroyGCPointers */
PROVIDE(AptNativeHash_DestroyGCPointers = 0x8046E1E0);
/* AptNativeHash_DestroyGCPointers(void*) */
PROVIDE(_Z31AptNativeHash_DestroyGCPointersPv = 0x800034C0);
/* AptNativeHash_DestroyGCPointers_ext(void*) */
PROVIDE(_Z35AptNativeHash_DestroyGCPointers_extPv = 0x800034C0);
/* AptNativeHash_Lookup */
PROVIDE(AptNativeHash_Lookup = 0x8046E1E0);
/* AptNativeHash_Lookup(void*, EAStringC*) */
PROVIDE(_Z20AptNativeHash_LookupPvP9EAStringC = 0x800034C0);
/* AptNativeHash_RegisterReferences */
PROVIDE(AptNativeHash_RegisterReferences = 0x8046E1E0);
/* AptNativeHash_SetIfNotExists */
PROVIDE(AptNativeHash_SetIfNotExists = 0x8046E1E0);
/* AptParagraph_vtable */
PROVIDE(AptParagraph_vtable = 0x8046E1E0);
/* AptString_Create(char*) */
PROVIDE(_Z16AptString_CreatePc = 0x800034C0);
/* AptValue_AddRef_impl */
PROVIDE(AptValue_AddRef_impl = 0x8046E1E0);
/* AptValue_Release */
PROVIDE(AptValue_Release = 0x8046E1E0);
/* AptVar_Hash */
PROVIDE(AptVar_Hash = 0x8046E1E0);
/* AptViewerFuncs::AddCmdToAptButtonFilter(AptViewer*, int, unsigned int, int) */
PROVIDE(_ZN14AptViewerFuncs23AddCmdToAptButtonFilterEP9AptVieweriji = 0x800034C0);
/* AptViewerFuncs::PopAptButtonFilter(AptViewer*, int, unsigned int) */
PROVIDE(_ZN14AptViewerFuncs18PopAptButtonFilterEP9AptViewerij = 0x800034C0);
/* AptViewerFuncs::PushAptButtonFilter(AptViewer*, int, char*) */
PROVIDE(_ZN14AptViewerFuncs19PushAptButtonFilterEP9AptVieweriPc = 0x800034C0);
/* AptViewerFuncs::RemoveCmdFromAptButtonFilter(AptViewer*, int, unsigned int, int) */
PROVIDE(_ZN14AptViewerFuncs28RemoveCmdFromAptButtonFilterEP9AptVieweriji = 0x800034C0);
/* AptViewer_Call */
PROVIDE(AptViewer_Call = 0x8046E1E0);
/* AptViewer_EnableInput */
PROVIDE(AptViewer_EnableInput = 0x8046E1E0);
/* BG_ExecuteState(char const*) */
PROVIDE(_Z15BG_ExecuteStatePKc = 0x800034C0);
/* BG_s_bBGComplete */
PROVIDE(BG_s_bBGComplete = 0x8046E1E0);
/* BuildRoomPartition(unsigned short, void*, bool) */
PROVIDE(_Z18BuildRoomPartitiontPvb = 0x800034C0);
/* DLAlloc(void*, unsigned int) */
PROVIDE(_Z7DLAllocPvj = 0x800034C0);
/* DLAllocExternal(void*, void*, int) */
PROVIDE(_Z15DLAllocExternalPvS_i = 0x800034C0);
/* DLValidate(void*) */
PROVIDE(_Z10DLValidatePv = 0x800034C0);
/* DOGMA_PoolManager_Allocate(void*, unsigned int) */
PROVIDE(_Z26DOGMA_PoolManager_AllocatePvj = 0x800034C0);
/* DOGMA_PoolManager_Deallocate(void*, void*, unsigned int) */
PROVIDE(_Z28DOGMA_PoolManager_DeallocatePvS_j = 0x800034C0);
/* DebugDrawSphere */
PROVIDE(DebugDrawSphere = 0x8046E1E0);
/* DialogPane_ClearAllItems */
PROVIDE(DialogPane_ClearAllItems = 0x8046E1E0);
/* DialogPane_HidePane */
PROVIDE(DialogPane_HidePane = 0x8046E1E0);
/* DialogPane_ShowPane */
PROVIDE(DialogPane_ShowPane = 0x8046E1E0);
/* DialogPane_Shutdown */
PROVIDE(DialogPane_Shutdown = 0x8046E1E0);
/* E3DWindow_Dtor */
PROVIDE(E3DWindow_Dtor = 0x8046E1E0);
/* E3DWindow_GetSize */
PROVIDE(E3DWindow_GetSize = 0x8046E1E0);
/* E3DWindow_Init */
PROVIDE(E3DWindow_Init = 0x8046E1E0);
/* E3DWindow_PopClipStack(E3DWindow&, int) */
PROVIDE(_Z22E3DWindow_PopClipStackR9E3DWindowi = 0x800034C0);
/* E3DWindow_Project */
PROVIDE(E3DWindow_Project = 0x8046E1E0);
/* E3DWindow_SetViewport */
PROVIDE(E3DWindow_SetViewport = 0x8046E1E0);
/* EAHeap_Alloc */
PROVIDE(EAHeap_Alloc = 0x8046E1E0);
/* EAHeap_AllocFromHeap(void*, unsigned int, int, int, int) */
PROVIDE(_Z20EAHeap_AllocFromHeapPvjiii = 0x800034C0);
/* EAHeap_Calloc(EAHeap*, unsigned int, unsigned int, int) */
PROVIDE(_Z13EAHeap_CallocP6EAHeapjji = 0x800034C0);
/* EAHeap_Free */
PROVIDE(EAHeap_Free = 0x8046E1E0);
/* EAHeap_Free(EAHeap*, void*) */
PROVIDE(_Z11EAHeap_FreeP6EAHeapPv = 0x800034C0);
/* EAHeap_Free2 */
PROVIDE(EAHeap_Free2 = 0x8046E1E0);
/* EAHeap_FreePtr */
PROVIDE(EAHeap_FreePtr = 0x8046E1E0);
/* EAHeap_FreeToHeap(void*, void*) */
PROVIDE(_Z17EAHeap_FreeToHeapPvS_ = 0x800034C0);
/* EAHeap_Get */
PROVIDE(EAHeap_Get = 0x8046E1E0);
/* EAHeap_GetCurrent() */
PROVIDE(_Z17EAHeap_GetCurrentv = 0x800034C0);
/* EAHeap_GetDebugHeap */
PROVIDE(EAHeap_GetDebugHeap = 0x8046E1E0);
/* EAHeap_GetMainHeap */
PROVIDE(EAHeap_GetMainHeap = 0x8046E1E0);
/* EAHeap_GetMovieHeap */
PROVIDE(EAHeap_GetMovieHeap = 0x8046E1E0);
/* EAHeap_GetResourceHeap */
PROVIDE(EAHeap_GetResourceHeap = 0x8046E1E0);
/* EAHeap_GetVMHeap */
PROVIDE(EAHeap_GetVMHeap = 0x8046E1E0);
/* EAHeap_Init1 */
PROVIDE(EAHeap_Init1 = 0x8046E1E0);
/* EAHeap_Init2 */
PROVIDE(EAHeap_Init2 = 0x8046E1E0);
/* EAHeap_Init3 */
PROVIDE(EAHeap_Init3 = 0x8046E1E0);
/* EAHeap_Init4 */
PROVIDE(EAHeap_Init4 = 0x8046E1E0);
/* EAHeap_Init5 */
PROVIDE(EAHeap_Init5 = 0x8046E1E0);
/* EAHeap_Init6 */
PROVIDE(EAHeap_Init6 = 0x8046E1E0);
/* EAHeap_Init7 */
PROVIDE(EAHeap_Init7 = 0x8046E1E0);
/* EAHeap_Init8 */
PROVIDE(EAHeap_Init8 = 0x8046E1E0);
/* EAHeap_InitAll */
PROVIDE(EAHeap_InitAll = 0x8046E1E0);
/* EAHeap_Malloc */
PROVIDE(EAHeap_Malloc = 0x8046E1E0);
/* EAHeap_MallocAligned */
PROVIDE(EAHeap_MallocAligned = 0x8046E1E0);
/* EAHeap_SetActive */
PROVIDE(EAHeap_SetActive = 0x8046E1E0);
/* EAMoneyFormat_Format */
PROVIDE(EAMoneyFormat_Format = 0x8046E1E0);
/* EAMoneyFormat_GetString */
PROVIDE(EAMoneyFormat_GetString = 0x8046E1E0);
/* EAMoneyFormat_Init */
PROVIDE(EAMoneyFormat_Init = 0x8046E1E0);
/* EAStringC_ChangeBuffer(EAStringC*, unsigned int, unsigned int, unsigned int, int, unsigned int) */
PROVIDE(_Z22EAStringC_ChangeBufferP9EAStringCjjjij = 0x800034C0);
/* EAStringC_TrimLeft(EAStringC*, char*) */
PROVIDE(_Z18EAStringC_TrimLeftP9EAStringCPc = 0x800034C0);
/* EAStringC_TrimRight(EAStringC*, char*) */
PROVIDE(_Z19EAStringC_TrimRightP9EAStringCPc = 0x800034C0);
/* EAStringC_assign */
PROVIDE(EAStringC_assign = 0x8046E1E0);
/* EAStringC_assign(EAStringC*, EAStringC*) */
PROVIDE(_Z16EAStringC_assignP9EAStringCS0_ = 0x800034C0);
/* EAStringC_cat_cstr(EAStringC*, char*) */
PROVIDE(_Z18EAStringC_cat_cstrP9EAStringCPc = 0x800034C0);
/* EAStringC_cat_str(EAStringC*, EAStringC*) */
PROVIDE(_Z17EAStringC_cat_strP9EAStringCS0_ = 0x800034C0);
/* EAStringC_dtor */
PROVIDE(EAStringC_dtor = 0x8046E1E0);
/* EAStringC_s_EmptyInternalData */
PROVIDE(EAStringC_s_EmptyInternalData = 0x8046E1E0);
/* EAnimController::SetTrackBlendFactors(unsigned int, float*) */
PROVIDE(_ZN15EAnimController20SetTrackBlendFactorsEjPf = 0x800034C0);
/* EAnimController_Init */
PROVIDE(EAnimController_Init = 0x8046E1E0);
/* EBitArray::operator==(EBitArray&) const */
PROVIDE(_ZNK9EBitArrayeqERS_ = 0x800034C0);
/* EController_BtnDataClear */
PROVIDE(EController_BtnDataClear = 0x8046E1E0);
/* EController_BtnDataUpdate */
PROVIDE(EController_BtnDataUpdate = 0x8046E1E0);
/* EController_ComputeExclMask */
PROVIDE(EController_ComputeExclMask = 0x8046E1E0);
/* EController_GetFilteredInput */
PROVIDE(EController_GetFilteredInput = 0x8046E1E0);
/* EController_GetInput */
PROVIDE(EController_GetInput = 0x8046E1E0);
/* EController_ReadInput */
PROVIDE(EController_ReadInput = 0x8046E1E0);
/* EDL_AddRef(void*, void*) */
PROVIDE(_Z10EDL_AddRefPvS_ = 0x800034C0);
/* EDL_Init(void*, unsigned int) */
PROVIDE(_Z8EDL_InitPvj = 0x800034C0);
/* EDebugMenuItem_vtable */
PROVIDE(EDebugMenuItem_vtable = 0x8046E1E0);
/* EFixedString::operator+=(char*) */
PROVIDE(_ZN12EFixedStringpLEPc = 0x800034C0);
/* EGameStateMan_SetState */
PROVIDE(EGameStateMan_SetState = 0x8046E1E0);
/* EGameState_vtable */
PROVIDE(EGameState_vtable = 0x8046E1E0);
/* EInstance_Destruct(EInstance*, int) */
PROVIDE(_Z18EInstance_DestructP9EInstancei = 0x800034C0);
/* EMat4_Id(EMat4*) */
PROVIDE(_Z8EMat4_IdP5EMat4 = 0x800034C0);
/* EMat4_Identity */
PROVIDE(EMat4_Identity = 0x8046E1E0);
/* EMat4_Mult4x4_Impl(EMat4&, EMat4&, EMat4&) */
PROVIDE(_Z18EMat4_Mult4x4_ImplR5EMat4S0_S0_ = 0x800034C0);
/* EPathUtil_FixTrailingSlash(char*, char*) */
PROVIDE(_Z26EPathUtil_FixTrailingSlashPcS_ = 0x800034C0);
/* EPathUtil_MakeLegalFilename(char*, char*) */
PROVIDE(_Z27EPathUtil_MakeLegalFilenamePcS_ = 0x800034C0);
/* EPathUtil_RemoveDriveLetter(char*, char*) */
PROVIDE(_Z27EPathUtil_RemoveDriveLetterPcS_ = 0x800034C0);
/* EPathUtil_RemoveTrailingSlash(char*, char*) */
PROVIDE(_Z29EPathUtil_RemoveTrailingSlashPcS_ = 0x800034C0);
/* EQuat_ExtractAxisAngle(EQuat*, EVec3*) */
PROVIDE(_Z22EQuat_ExtractAxisAngleP5EQuatP5EVec3 = 0x800034C0);
/* EQuat_ToMat4(EQuat*, EMat4*) */
PROVIDE(_Z12EQuat_ToMat4P5EQuatP5EMat4 = 0x800034C0);
/* ERAnimController_Dtor */
PROVIDE(ERAnimController_Dtor = 0x8046E1E0);
/* ERAnimController_Init */
PROVIDE(ERAnimController_Init = 0x8046E1E0);
/* ERAnimController_Release */
PROVIDE(ERAnimController_Release = 0x8046E1E0);
/* ERAnimInit */
PROVIDE(ERAnimInit = 0x8046E1E0);
/* ERAnim_Play */
PROVIDE(ERAnim_Play = 0x8046E1E0);
/* ERAnim_SetAnim */
PROVIDE(ERAnim_SetAnim = 0x8046E1E0);
/* ERAnim_Stop */
PROVIDE(ERAnim_Stop = 0x8046E1E0);
/* ERC_Construct(void*) */
PROVIDE(_Z13ERC_ConstructPv = 0x800034C0);
/* ERC_ModelMatrix */
PROVIDE(ERC_ModelMatrix = 0x8046E1E0);
/* ERC_RestoreState */
PROVIDE(ERC_RestoreState = 0x8046E1E0);
/* ERC_SaveState */
PROVIDE(ERC_SaveState = 0x8046E1E0);
/* ERLevel_Destruct(ERLevel*, int) */
PROVIDE(_Z16ERLevel_DestructP7ERLeveli = 0x800034C0);
/* ERLevel_InsertInOrderTable(ERLevel*, EOrderTableData&) */
PROVIDE(_Z26ERLevel_InsertInOrderTableP7ERLevelR15EOrderTableData = 0x800034C0);
/* ERLevel_RemoveInstance(ERLevel*, EInstance*) */
PROVIDE(_Z22ERLevel_RemoveInstanceP7ERLevelP9EInstance = 0x800034C0);
/* ERModel_Draw */
PROVIDE(ERModel_Draw = 0x8046E1E0);
/* ERShader_Release */
PROVIDE(ERShader_Release = 0x8046E1E0);
/* ERShader_Release_v */
PROVIDE(ERShader_Release_v = 0x8046E1E0);
/* ERTexture_Create */
PROVIDE(ERTexture_Create = 0x8046E1E0);
/* EShader_Select */
PROVIDE(EShader_Select = 0x8046E1E0);
/* EStorable_BaseCtor */
PROVIDE(EStorable_BaseCtor = 0x8046E1E0);
/* EStorable_CreateCopy(EStorable const*) */
PROVIDE(_Z20EStorable_CreateCopyPK9EStorable = 0x800034C0);
/* EStorable_CreateCopy(EStorable*) */
PROVIDE(_Z20EStorable_CreateCopyP9EStorable = 0x800034C0);
/* EStorable_Destructor(EStorable*, int) */
PROVIDE(_Z20EStorable_DestructorP9EStorablei = 0x800034C0);
/* EStorable_FileIn(EFile&, EStorable*&) */
PROVIDE(_Z16EStorable_FileInR5EFileRP9EStorable = 0x800034C0);
/* EStorable_New(unsigned int) */
PROVIDE(_Z13EStorable_Newj = 0x800034C0);
/* EStorable_StreamIn(EStream&, EStorable*&) */
PROVIDE(_Z18EStorable_StreamInR7EStreamRP9EStorable = 0x800034C0);
/* EStorable_StreamOut(EStream&, EStorable*) */
PROVIDE(_Z19EStorable_StreamOutR7EStreamP9EStorable = 0x800034C0);
/* EStorable_vtable */
PROVIDE(EStorable_vtable = 0x8046E1E0);
/* EStr_Copy(void*, char const*) */
PROVIDE(_Z9EStr_CopyPvPKc = 0x800034C0);
/* EStr_Init(void*) */
PROVIDE(_Z9EStr_InitPv = 0x800034C0);
/* EStream_WriteU16String(EStream&, unsigned short*) */
PROVIDE(_Z22EStream_WriteU16StringR7EStreamPt = 0x800034C0);
/* EString_assign(void*, char const*) */
PROVIDE(_Z14EString_assignPvPKc = 0x800034C0);
/* EString_c_str(void*) */
PROVIDE(_Z13EString_c_strPv = 0x800034C0);
/* EString_fopen */
PROVIDE(EString_fopen = 0x8046E1E0);
/* EVec3_Length(EVec3*) */
PROVIDE(_Z12EVec3_LengthP5EVec3 = 0x800034C0);
/* EventSystem_PostEvent */
PROVIDE(EventSystem_PostEvent = 0x8046E1E0);
/* Family_vtable */
PROVIDE(Family_vtable = 0x8046E1E0);
/* FastAllocPool::Validate() */
PROVIDE(_ZN13FastAllocPool8ValidateEv = 0x800034C0);
/* FastAllocPool_Alloc(void*, unsigned int) */
PROVIDE(_Z19FastAllocPool_AllocPvj = 0x800034C0);
/* FrameEffectsManager_Create */
PROVIDE(FrameEffectsManager_Create = 0x8046E1E0);
/* FrameEffectsManager_Destroy */
PROVIDE(FrameEffectsManager_Destroy = 0x8046E1E0);
/* GetAptButtonFilterName */
PROVIDE(GetAptButtonFilterName = 0x8046E1E0);
/* GlobalConstantsClient_Construct(void*, int) */
PROVIDE(_Z31GlobalConstantsClient_ConstructPvi = 0x800034C0);
/* Globs_InitSomething */
PROVIDE(Globs_InitSomething = 0x8046E1E0);
/* InteractorManager_GetInteractor */
PROVIDE(InteractorManager_GetInteractor = 0x8046E1E0);
/* InteractorManager_GetSingleton */
PROVIDE(InteractorManager_GetSingleton = 0x8046E1E0);
/* Interests_Init(void*) */
PROVIDE(_Z14Interests_InitPv = 0x800034C0);
/* MoviePlayerEndgameMovieState_vtable */
PROVIDE(MoviePlayerEndgameMovieState_vtable = 0x8046E1E0);
/* MoviePlayer_IsPlaying */
PROVIDE(MoviePlayer_IsPlaying = 0x8046E1E0);
/* MoviePlayer_StopMovie */
PROVIDE(MoviePlayer_StopMovie = 0x8046E1E0);
/* Neighbor::GetRelationshipByGUID(int) */
PROVIDE(_ZN8Neighbor21GetRelationshipByGUIDEi = 0x800034C0);
/* Neighbor::RecalculateRelationshipCounts() */
PROVIDE(_ZN8Neighbor29RecalculateRelationshipCountsEv = 0x800034C0);
/* NeighborhoodImpl::CreateFamily(int, int) */
PROVIDE(_ZN16NeighborhoodImpl12CreateFamilyEii = 0x800034C0);
/* NeighborhoodImpl::RecalculateFamilyFriends() */
PROVIDE(_ZN16NeighborhoodImpl24RecalculateFamilyFriendsEv = 0x800034C0);
/* Neighborhood_GetFirst */
PROVIDE(Neighborhood_GetFirst = 0x8046E1E0);
/* NghResFile_GetNghCount */
PROVIDE(NghResFile_GetNghCount = 0x8046E1E0);
/* OSSemPost */
PROVIDE(OSSemPost = 0x8046E1E0);
/* ObjSelector_GetAdultAnimTable(ObjSelector*) */
PROVIDE(_Z29ObjSelector_GetAdultAnimTableP11ObjSelector = 0x800034C0);
/* ObjSelector_GetChildAnimTable(ObjSelector*) */
PROVIDE(_Z29ObjSelector_GetChildAnimTableP11ObjSelector = 0x800034C0);
/* ObjSelector_GetFnTable(ObjSelector*) */
PROVIDE(_Z22ObjSelector_GetFnTableP11ObjSelector = 0x800034C0);
/* ObjSelector_GetSelFile(ObjSelector*) */
PROVIDE(_Z22ObjSelector_GetSelFileP11ObjSelector = 0x800034C0);
/* ObjSelector_GetTreeTab(ObjSelector*) */
PROVIDE(_Z22ObjSelector_GetTreeTabP11ObjSelector = 0x800034C0);
/* ObjSelector_LoadSelFile(ObjSelector*) */
PROVIDE(_Z23ObjSelector_LoadSelFileP11ObjSelector = 0x800034C0);
/* ObjectDataBehaviorTree::AddRef() */
PROVIDE(_ZN22ObjectDataBehaviorTree6AddRefEv = 0x800034C0);
/* ObjectDataBehaviorTree::GetDataSourceType() const */
PROVIDE(_ZNK22ObjectDataBehaviorTree17GetDataSourceTypeEv = 0x800034C0);
/* ObjectDataBehaviorTree::GetFromDataID(ObjectDataID&) */
PROVIDE(_ZN22ObjectDataBehaviorTree13GetFromDataIDER12ObjectDataID = 0x800034C0);
/* ObjectDataBehaviorTree::LoadFromDataID(ObjectDataID&) */
PROVIDE(_ZN22ObjectDataBehaviorTree14LoadFromDataIDER12ObjectDataID = 0x800034C0);
/* ObjectDataBehaviorTree::LoadFromIndex(unsigned int, int) */
PROVIDE(_ZN22ObjectDataBehaviorTree13LoadFromIndexEji = 0x800034C0);
/* ObjectDataBehaviorTree::LoadOnlyNameAndIDFromIndex(unsigned int, int) */
PROVIDE(_ZN22ObjectDataBehaviorTree26LoadOnlyNameAndIDFromIndexEji = 0x800034C0);
/* ObjectDataBehaviorTree::QueryInterface(unsigned int, void**) */
PROVIDE(_ZN22ObjectDataBehaviorTree14QueryInterfaceEjPPv = 0x800034C0);
/* ObjectDataBehaviorTree::Release() */
PROVIDE(_ZN22ObjectDataBehaviorTree7ReleaseEv = 0x800034C0);
/* ObjectDataBehaviorTree::SaveDataByID(ObjectDataID&) */
PROVIDE(_ZN22ObjectDataBehaviorTree12SaveDataByIDER12ObjectDataID = 0x800034C0);
/* ObjectDataID::ObjectDataID(ObjectDataID const&) */
PROVIDE(_ZN12ObjectDataIDC1ERKS_ = 0x800034C0);
/* ObjectList_Next */
PROVIDE(ObjectList_Next = 0x8046E1E0);
/* ObjectModule_CreateInstance */
PROVIDE(ObjectModule_CreateInstance = 0x8046E1E0);
/* OptionsRecon_PreservePreferences(void*) */
PROVIDE(_Z32OptionsRecon_PreservePreferencesPv = 0x800034C0);
/* OptionsRecon_RestorePreferences(void*) */
PROVIDE(_Z31OptionsRecon_RestorePreferencesPv = 0x800034C0);
/* PassiveInfluenceSystem_Create */
PROVIDE(PassiveInfluenceSystem_Create = 0x8046E1E0);
/* ProtectedAllocPool::Validate() */
PROVIDE(_ZN18ProtectedAllocPool8ValidateEv = 0x800034C0);
/* ReconBuffer_StreamInline(ReconBuffer*, void*, int) */
PROVIDE(_Z24ReconBuffer_StreamInlineP11ReconBufferPvi = 0x800034C0);
/* RoomList_Init */
PROVIDE(RoomList_Init = 0x8046E1E0);
/* SmallBlockAllocator_Alloc */
PROVIDE(SmallBlockAllocator_Alloc = 0x8046E1E0);
/* SmallBlockAllocator_Free */
PROVIDE(SmallBlockAllocator_Free = 0x8046E1E0);
/* SpacePartition_GetFloorType */
PROVIDE(SpacePartition_GetFloorType = 0x8046E1E0);
/* SpacePartition_GetTileCount */
PROVIDE(SpacePartition_GetTileCount = 0x8046E1E0);
/* StateMachineState_OwnerSetNextState */
PROVIDE(StateMachineState_OwnerSetNextState = 0x8046E1E0);
/* StateMachine_BaseCtor */
PROVIDE(StateMachine_BaseCtor = 0x8046E1E0);
/* StateMachine_SetState */
PROVIDE(StateMachine_SetState = 0x8046E1E0);
/* StringBuffer2_Set(StringBuffer2*, char const*) */
PROVIDE(_Z17StringBuffer2_SetP13StringBuffer2PKc = 0x800034C0);
/* StringBuffer2_c_str(StringBuffer2*) */
PROVIDE(_Z19StringBuffer2_c_strP13StringBuffer2 = 0x800034C0);
/* StringBuffer_Clear(StringBuffer&) */
PROVIDE(_Z18StringBuffer_ClearR12StringBuffer = 0x800034C0);
/* TArray<EILight*, TArrayDefaultAllocator>::Deallocate() */
PROVIDE(_ZN6TArrayIP7EILight22TArrayDefaultAllocatorE10DeallocateEv = 0x800034C0);
/* TArray<EILight*, TArrayDefaultAllocator>::Insert(EILight**, int, int) */
PROVIDE(_ZN6TArrayIP7EILight22TArrayDefaultAllocatorE6InsertEPS1_ii = 0x800034C0);
/* TArray<EString, TArrayDefaultAllocator>::Insert(EString*, int, int) */
PROVIDE(_ZN6TArrayI7EString22TArrayDefaultAllocatorE6InsertEPS0_ii = 0x800034C0);
/* TArray<EString2, TArrayDefaultAllocator>::Insert(EString2*, int, int) */
PROVIDE(_ZN6TArrayI8EString222TArrayDefaultAllocatorE6InsertEPS0_ii = 0x800034C0);
/* TArray<EVec3, TArrayDefaultAllocator>::Copy(EVec3*, EVec3*, int) */
PROVIDE(_ZN6TArrayI5EVec322TArrayDefaultAllocatorE4CopyEPS0_S3_i = 0x800034C0);
/* TArray<EVec3, TArrayDefaultAllocator>::Destruct(EVec3*, int) */
PROVIDE(_ZN6TArrayI5EVec322TArrayDefaultAllocatorE8DestructEPS0_i = 0x800034C0);
/* TArray<EVec3, TArrayDefaultAllocator>::Init() */
PROVIDE(_ZN6TArrayI5EVec322TArrayDefaultAllocatorE4InitEv = 0x800034C0);
/* TArray<EVec3, TArrayDefaultAllocator>::SetSize(int, int) */
PROVIDE(_ZN6TArrayI5EVec322TArrayDefaultAllocatorE7SetSizeEii = 0x800034C0);
/* TArray<EVec3, TArrayDefaultAllocator>::TArray() */
PROVIDE(_ZN6TArrayI5EVec322TArrayDefaultAllocatorEC1Ev = 0x800034C0);
/* TArray<EVec3, TArrayDefaultAllocator>::~TArray() */
PROVIDE(_ZN6TArrayI5EVec322TArrayDefaultAllocatorED1Ev = 0x800034C0);
/* TArray_ENCameraPoint_Resize */
PROVIDE(TArray_ENCameraPoint_Resize = 0x8046E1E0);
/* TextBaseItem_SetStyle */
PROVIDE(TextBaseItem_SetStyle = 0x8046E1E0);
/* TextBlock_Draw */
PROVIDE(TextBlock_Draw = 0x8046E1E0);
/* TextBlock_SetDirty */
PROVIDE(TextBlock_SetDirty = 0x8046E1E0);
/* UIQDTarget_UIQDSubstitutionStrings(unsigned short*) */
PROVIDE(_Z34UIQDTarget_UIQDSubstitutionStringsPt = 0x800034C0);
/* Vec3_Length */
PROVIDE(Vec3_Length = 0x8046E1E0);
/* Vec3_Length2 */
PROVIDE(Vec3_Length2 = 0x8046E1E0);
/* Vec3_Normalize */
PROVIDE(Vec3_Normalize = 0x8046E1E0);
/* Vector_push_back */
PROVIDE(Vector_push_back = 0x8046E1E0);
/* WrapperPaneBase_CalcAccept */
PROVIDE(WrapperPaneBase_CalcAccept = 0x8046E1E0);
/* WrapperPaneBase_CalcDecline */
PROVIDE(WrapperPaneBase_CalcDecline = 0x8046E1E0);
/* WrapperPaneBase_RecalcLayout */
PROVIDE(WrapperPaneBase_RecalcLayout = 0x8046E1E0);
/* WrapperPaneBase_SetVariable */
PROVIDE(WrapperPaneBase_SetVariable = 0x8046E1E0);
/* Wrapper_Draw */
PROVIDE(Wrapper_Draw = 0x8046E1E0);
/* Wrapper_ReadInput */
PROVIDE(Wrapper_ReadInput = 0x8046E1E0);
/* Wrapper_ReleasePaneEvent */
PROVIDE(Wrapper_ReleasePaneEvent = 0x8046E1E0);
/* Wrapper_ShowPane */
PROVIDE(Wrapper_ShowPane = 0x8046E1E0);
/* Wrapper_UpdateItems */
PROVIDE(Wrapper_UpdateItems = 0x8046E1E0);
/* _Bs_G_S_first_one */
PROVIDE(_Bs_G_S_first_one = 0x8046E1E0);
/* _ParticlePoolClose */
PROVIDE(_ParticlePoolClose = 0x8046E1E0);
/* _ParticlePoolFree */
PROVIDE(_ParticlePoolFree = 0x8046E1E0);
/* _ParticleProcessType3Impl */
PROVIDE(_ParticleProcessType3Impl = 0x8046E1E0);
/* _RingAlloc */
PROVIDE(_RingAlloc = 0x8046E1E0);
/* _RingReset */
PROVIDE(_RingReset = 0x8046E1E0);
/* _SDA2_BASE_ */
PROVIDE(_SDA2_BASE_ = 0x8046E1E0);
/* _SDA2_delta_time */
PROVIDE(_SDA2_delta_time = 0x8046E1E0);
/* _SDA_BASE_ */
PROVIDE(_SDA_BASE_ = 0x8046E1E0);
/* __node_alloc_false_0_M_deallocate(void*, unsigned int) */
PROVIDE(_Z33__node_alloc_false_0_M_deallocatePvj = 0x800034C0);
/* __node_alloc_false_0_S_free_list */
PROVIDE(__node_alloc_false_0_S_free_list = 0x8046E1E0);
/* __node_alloc_false_0_S_refill(unsigned int) */
PROVIDE(_Z29__node_alloc_false_0_S_refillj = 0x800034C0);
/* __static_init_helper */
PROVIDE(__static_init_helper = 0x8046E1E0);
/* _appNameStr */
PROVIDE(_appNameStr = 0x8046E1E0);
/* _bss_end */
PROVIDE(_bss_end = 0x8046E1E0);
/* _bss_start */
PROVIDE(_bss_start = 0x8046E1E0);
/* _buildVersionStr */
PROVIDE(_buildVersionStr = 0x8046E1E0);
/* _frameIndex */
PROVIDE(_frameIndex = 0x8046E1E0);
/* _gravityMagnitude */
PROVIDE(_gravityMagnitude = 0x8046E1E0);
/* _heapUseInfoName_DMA */
PROVIDE(_heapUseInfoName_DMA = 0x8046E1E0);
/* _heapUseInfoName_Dma2 */
PROVIDE(_heapUseInfoName_Dma2 = 0x8046E1E0);
/* _heapUseInfoName_Matrix */
PROVIDE(_heapUseInfoName_Matrix = 0x8046E1E0);
/* _heapUseInfoName_System */
PROVIDE(_heapUseInfoName_System = 0x8046E1E0);
/* _heapUseInfoName_Texture */
PROVIDE(_heapUseInfoName_Texture = 0x8046E1E0);
/* _minRetraces */
PROVIDE(_minRetraces = 0x8046E1E0);
/* _sbss_end */
PROVIDE(_sbss_end = 0x8046E1E0);
/* _sbss_start */
PROVIDE(_sbss_start = 0x8046E1E0);
/* _stack_addr */
PROVIDE(_stack_addr = 0x8046E1E0);
/* acosf_wrapper */
PROVIDE(acosf_wrapper = 0x8046E1E0);
/* atoi_impl */
PROVIDE(atoi_impl = 0x8046E1E0);
/* cBoxX_Event(void*, int, int, int, ERSoundEvent*, float) */
PROVIDE(_Z11cBoxX_EventPviiiP12ERSoundEventf = 0x800034C0);
/* cBoxX_IsSoundFinished */
PROVIDE(cBoxX_IsSoundFinished = 0x8046E1E0);
/* cBoxX_MappedEvent(void*, ERSoundEvent*, int, float) */
PROVIDE(_Z17cBoxX_MappedEventPvP12ERSoundEventif = 0x800034C0);
/* cBoxX_PauseSound */
PROVIDE(cBoxX_PauseSound = 0x8046E1E0);
/* cBoxX_SetSoundPosition */
PROVIDE(cBoxX_SetSoundPosition = 0x8046E1E0);
/* cBoxX_StopSound */
PROVIDE(cBoxX_StopSound = 0x8046E1E0);
/* cBoxX_UnPauseSound */
PROVIDE(cBoxX_UnPauseSound = 0x8046E1E0);
/* cSampleChannel_SetPan(cSampleChannel*, int) */
PROVIDE(_Z21cSampleChannel_SetPanP14cSampleChanneli = 0x800034C0);
/* cSampleChannel_SetVolume(cSampleChannel*, int) */
PROVIDE(_Z24cSampleChannel_SetVolumeP14cSampleChanneli = 0x800034C0);
/* cSimulator_CreateInstance */
PROVIDE(cSimulator_CreateInstance = 0x8046E1E0);
/* cSoundCache_GetTrackObject(cSoundCache*, ERSoundEvent*, bool) */
PROVIDE(_Z26cSoundCache_GetTrackObjectP11cSoundCacheP12ERSoundEventb = 0x800034C0);
/* cSoundModeManager_SetMode(void*, int) */
PROVIDE(_Z25cSoundModeManager_SetModePvi = 0x800034C0);
/* cXMTObjectImpl_Initialize(void*) */
PROVIDE(_Z25cXMTObjectImpl_InitializePv = 0x800034C0);
/* cosf_impl */
PROVIDE(cosf_impl = 0x8046E1E0);
/* gAptAllocFunc */
PROVIDE(gAptAllocFunc = 0x8046E1E0);
/* gAptFreeFunc */
PROVIDE(gAptFreeFunc = 0x8046E1E0);
/* g_aptRouterObj */
PROVIDE(g_aptRouterObj = 0x8046E1E0);
/* g_aptViewerObj */
PROVIDE(g_aptViewerObj = 0x8046E1E0);
/* g_bDrawTopmost */
PROVIDE(g_bDrawTopmost = 0x8046E1E0);
/* g_deleteFileParam */
PROVIDE(g_deleteFileParam = 0x8046E1E0);
/* g_globNamespaceID */
PROVIDE(g_globNamespaceID = 0x8046E1E0);
/* g_numPlayers */
PROVIDE(g_numPlayers = 0x8046E1E0);
/* g_pCameraDebug */
PROVIDE(g_pCameraDebug = 0x8046E1E0);
/* g_pComeSeeMeSelector */
PROVIDE(g_pComeSeeMeSelector = 0x8046E1E0);
/* g_pControllerManager */
PROVIDE(g_pControllerManager = 0x8046E1E0);
/* g_pInputMgr */
PROVIDE(g_pInputMgr = 0x8046E1E0);
/* g_pMemCardInterface */
PROVIDE(g_pMemCardInterface = 0x8046E1E0);
/* g_pObjectModule */
PROVIDE(g_pObjectModule = 0x8046E1E0);
/* g_pOptionsRecon */
PROVIDE(g_pOptionsRecon = 0x8046E1E0);
/* g_pRoomMgr */
PROVIDE(g_pRoomMgr = 0x8046E1E0);
/* g_pSimulator */
PROVIDE(g_pSimulator = 0x8046E1E0);
/* g_pSoundBox */
PROVIDE(g_pSoundBox = 0x8046E1E0);
/* g_pSoundPlayer */
PROVIDE(g_pSoundPlayer = 0x8046E1E0);
/* g_pStateMachineManager */
PROVIDE(g_pStateMachineManager = 0x8046E1E0);
/* g_savedGameMode */
PROVIDE(g_savedGameMode = 0x8046E1E0);
/* g_simSpeedSDA */
PROVIDE(g_simSpeedSDA = 0x8046E1E0);
/* g_simsCamParams */
PROVIDE(g_simsCamParams = 0x8046E1E0);
/* g_wallTypeIds */
PROVIDE(g_wallTypeIds = 0x8046E1E0);
/* gpAptAllocator */
PROVIDE(gpAptAllocator = 0x8046E1E0);
/* kDefaultMusicVolume */
PROVIDE(kDefaultMusicVolume = 0x8046E1E0);
/* kTimerDoubleConv */
PROVIDE(kTimerDoubleConv = 0x8046E1E0);
/* kTimerHalfScale */
PROVIDE(kTimerHalfScale = 0x8046E1E0);
/* kTimerInitSentinel */
PROVIDE(kTimerInitSentinel = 0x8046E1E0);
/* kTimerMaxFrame */
PROVIDE(kTimerMaxFrame = 0x8046E1E0);
/* kTimerTickScale */
PROVIDE(kTimerTickScale = 0x8046E1E0);
/* memcpy_impl */
PROVIDE(memcpy_impl = 0x8046E1E0);
/* memcpy_wrapper(void*, void const*, unsigned int) */
PROVIDE(_Z14memcpy_wrapperPvPKvj = 0x800034C0);
/* operator delete(void*, unsigned int) */
PROVIDE(_ZdlPvj = 0x800034C0);
/* operator new(unsigned int) */
PROVIDE(_Znwj = 0x800034C0);
/* operator<<(EStream&, EStorable*) */
PROVIDE(_ZlsR7EStreamP9EStorable = 0x800034C0);
/* operator>>(EFile&, EStorable*&) */
PROVIDE(_ZrsR5EFileRP9EStorable = 0x800034C0);
/* operator>>(EStream&, EStorable*&) */
PROVIDE(_ZrsR7EStreamRP9EStorable = 0x800034C0);
/* operator_delete */
PROVIDE(operator_delete = 0x8046E1E0);
/* operator_delete_wrapper */
PROVIDE(operator_delete_wrapper = 0x8046E1E0);
/* operator_new */
PROVIDE(operator_new = 0x8046E1E0);
/* operator_new(unsigned int) */
PROVIDE(_Z12operator_newj = 0x800034C0);
/* operator_new_wrapper */
PROVIDE(operator_new_wrapper = 0x8046E1E0);
/* printf(char const*, ...) */
PROVIDE(_Z6printfPKcz = 0x800034C0);
/* printf_debug */
PROVIDE(printf_debug = 0x8046E1E0);
/* pushAptButtonFilterImpl */
PROVIDE(pushAptButtonFilterImpl = 0x8046E1E0);
/* sAspScoreAdd */
PROVIDE(sAspScoreAdd = 0x8046E1E0);
/* sAspScoreDiv */
PROVIDE(sAspScoreDiv = 0x8046E1E0);
/* sAspScoreMul */
PROVIDE(sAspScoreMul = 0x8046E1E0);
/* sAspScoreSetDiv */
PROVIDE(sAspScoreSetDiv = 0x8046E1E0);
/* sAspScoreSetMul */
PROVIDE(sAspScoreSetMul = 0x8046E1E0);
/* sAspScoreSetSub */
PROVIDE(sAspScoreSetSub = 0x8046E1E0);
/* sInputManager */
PROVIDE(sInputManager = 0x8046E1E0);
/* sLotPositionTable */
PROVIDE(sLotPositionTable = 0x8046E1E0);
/* sSleepThreshold */
PROVIDE(sSleepThreshold = 0x8046E1E0);
/* sTypeInfo_IShrubObject */
PROVIDE(sTypeInfo_IShrubObject = 0x8046E1E0);
/* sTypeInfo_ISimsCounterTopObject */
PROVIDE(sTypeInfo_ISimsCounterTopObject = 0x8046E1E0);
/* sTypeInfo_ISimsMultiTileObjectModel */
PROVIDE(sTypeInfo_ISimsMultiTileObjectModel = 0x8046E1E0);
/* sTypeInfo_ISimsObjectModel */
PROVIDE(sTypeInfo_ISimsObjectModel = 0x8046E1E0);
/* sTypeInfo_ISimsWallObjectModel */
PROVIDE(sTypeInfo_ISimsWallObjectModel = 0x8046E1E0);
/* sVisualizer */
PROVIDE(sVisualizer = 0x8046E1E0);
/* s_accumTime */
PROVIDE(s_accumTime = 0x8046E1E0);
/* s_booleanFreeList */
PROVIDE(s_booleanFreeList = 0x8046E1E0);
/* s_buttonFontSize */
PROVIDE(s_buttonFontSize = 0x8046E1E0);
/* s_buttonItemStyle */
PROVIDE(s_buttonItemStyle = 0x8046E1E0);
/* s_casLotData */
PROVIDE(s_casLotData = 0x8046E1E0);
/* s_clipStackIndex */
PROVIDE(s_clipStackIndex = 0x8046E1E0);
/* s_defaultFont */
PROVIDE(s_defaultFont = 0x8046E1E0);
/* s_defaultFontSize */
PROVIDE(s_defaultFontSize = 0x8046E1E0);
/* s_deltaTicks */
PROVIDE(s_deltaTicks = 0x8046E1E0);
/* s_deltaTime */
PROVIDE(s_deltaTime = 0x8046E1E0);
/* s_floatFreeList */
PROVIDE(s_floatFreeList = 0x8046E1E0);
/* s_float_1_0 */
PROVIDE(s_float_1_0 = 0x8046E1E0);
/* s_float_2_0 */
PROVIDE(s_float_2_0 = 0x8046E1E0);
/* s_float_m1_0 */
PROVIDE(s_float_m1_0 = 0x8046E1E0);
/* s_g2dInitComplete */
PROVIDE(s_g2dInitComplete = 0x8046E1E0);
/* s_ingRefrigeratorLevel */
PROVIDE(s_ingRefrigeratorLevel = 0x8046E1E0);
/* s_integerFreeList */
PROVIDE(s_integerFreeList = 0x8046E1E0);
/* s_isGenerating */
PROVIDE(s_isGenerating = 0x8046E1E0);
/* s_k2yMode */
PROVIDE(s_k2yMode = 0x8046E1E0);
/* s_lastFrameTime */
PROVIDE(s_lastFrameTime = 0x8046E1E0);
/* s_menuFontSize */
PROVIDE(s_menuFontSize = 0x8046E1E0);
/* s_menuItemStyle */
PROVIDE(s_menuItemStyle = 0x8046E1E0);
/* s_mmuSingleton */
PROVIDE(s_mmuSingleton = 0x8046E1E0);
/* s_mt */
PROVIDE(s_mt = 0x8046E1E0);
/* s_mtIndex */
PROVIDE(s_mtIndex = 0x8046E1E0);
/* s_onlinePrefsPreserved */
PROVIDE(s_onlinePrefsPreserved = 0x8046E1E0);
/* s_pazTLA */
PROVIDE(s_pazTLA = 0x8046E1E0);
/* s_prevFrameTime */
PROVIDE(s_prevFrameTime = 0x8046E1E0);
/* s_prevTotalTicks */
PROVIDE(s_prevTotalTicks = 0x8046E1E0);
/* s_pz1TLA */
PROVIDE(s_pz1TLA = 0x8046E1E0);
/* s_savedFirstName */
PROVIDE(s_savedFirstName = 0x8046E1E0);
/* s_savedLastName */
PROVIDE(s_savedLastName = 0x8046E1E0);
/* s_srandSeed */
PROVIDE(s_srandSeed = 0x8046E1E0);
/* s_textItemStyle */
PROVIDE(s_textItemStyle = 0x8046E1E0);
/* s_totalTicks */
PROVIDE(s_totalTicks = 0x8046E1E0);
/* s_totalTime */
PROVIDE(s_totalTime = 0x8046E1E0);
/* sinf_impl */
PROVIDE(sinf_impl = 0x8046E1E0);
/* small_alloc */
PROVIDE(small_alloc = 0x8046E1E0);
/* small_free */
PROVIDE(small_free = 0x8046E1E0);
/* sprintf_impl */
PROVIDE(sprintf_impl = 0x8046E1E0);
/* strcmp_impl */
PROVIDE(strcmp_impl = 0x8046E1E0);
/* strcmp_n */
PROVIDE(strcmp_n = 0x8046E1E0);
/* strncmp_impl */
PROVIDE(strncmp_impl = 0x8046E1E0);
/* strncpy_safe */
PROVIDE(strncpy_safe = 0x8046E1E0);
/* swprintf_impl */
PROVIDE(swprintf_impl = 0x8046E1E0);
/* vtable for Behavior */
PROVIDE(_ZTV8Behavior = 0x8046E1E0);
/* vtable for CareersImpl */
PROVIDE(_ZTV11CareersImpl = 0x8046E1E0);
/* vtable for ENgcFileSystem */
PROVIDE(_ZTV14ENgcFileSystem = 0x8046E1E0);
/* vtable for IconGroupImpl */
PROVIDE(_ZTV13IconGroupImpl = 0x8046E1E0);
/* vtable for PassiveInfluenceTarget */
PROVIDE(_ZTV22PassiveInfluenceTarget = 0x8046E1E0);
/* wcsncpy2 */
PROVIDE(wcsncpy2 = 0x8046E1E0);
/* wcsncpy_impl */
PROVIDE(wcsncpy_impl = 0x8046E1E0);

